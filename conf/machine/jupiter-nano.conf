## conf/machine/jupiter-nano.conf
```bitbake
#@TYPE: Machine
#@Name: Jupiter Nano
#@DESCRIPTION: Machine configuration for Jupiter Nano

require include/sama5d2.inc

MACHINE_FEATURES = "apm alsa ext2 ext3 usbhost usbgadget "
KERNEL_DEVICETREE = " \
		at91-sama5d27_jupiter_nano.dtb \
		"

do_image_wic[depends] += "u-boot-at91:do_deploy"
IMAGE_FSTYPES += " tar.gz wic"
WKS_FILE = "sdimage-bootpart.wks"

IMAGE_BOOT_FILES = "BOOT.BIN u-boot.bin uboot.env at91-sama5d27_jupiter_nano.itb \
                    "

UBOOT_MACHINE ?= "at91-sama5d27_jupiter_nano_mmc_defconfig"
UBOOT_ENTRYPOINT = "0x20008000"
UBOOT_LOADADDRESS = "0x20008000"
UBOOT_ENV_SIZE = "0x4000"

AT91BOOTSTRAP_MACHINE ?= "sama5d27_jupiter_nano_sd1"

# Needed for FIT
MACHINE_ESSENTIAL_EXTRA_RDEPENDS = " dt-overlay-at91"
```
